## samples/wifi/twt/modules/traffic_gen/Kconfig
```kconfig
#
# Copyright (c) 2023 Nordic Semiconductor
#
# SPDX-License-Identifier: LicenseRef-Nordic-5-Clause
#
#
config TRAFFIC_GEN
	bool "Traffic generation module"
	select NET_CONTEXT_RCVTIMEO

choice TRAFFIC_GEN_SELECT_ROLE
	prompt "APP should be either client or server"
	default TRAFFIC_GEN_CLIENT

config TRAFFIC_GEN_CLIENT
	bool "Traffic gen module acts as a Client"
	help
	  Send uplink traffic to traffic gen server

config TRAFFIC_GEN_SERVER
	bool "Traffic gen module acts as a Server"
	help
	  Receive downlink traffic from traffic gen client (A python
	  client running in Cloud).

endchoice

config TRAFFIC_GEN_DURATION
	int "Traffic gen will simulate traffic for a specified duration"
	default 30
	help
	  How long traffic gen should simulate traffic

config TRAFFIC_GEN_REMOTE_IPV4_ADDR
	string "Traffic gen remote host IPv4 address"
	default "192.168.1.140"
	help
	  Traffic gen server IPv4 address

config TRAFFIC_GEN_REMOTE_PORT_NUM
	int "Traffic gen remote host port number"
	default 7777
	help
	  Traffic gen remote host port number

config TRAFFIC_GEN_PAYLOAD_SIZE
	int "Traffic gen payload size"
	default 1024
	help
	  Payload size of the traffic gen packets

config TRAFFIC_GEN_TYPE_TCP
	bool "Traffic type"
	default y
	help
	  Specifies the traffic type to be TCP

module = TRAFFIC_GEN
module-dep = LOG
module-str = Log level for sample
source "${ZEPHYR_BASE}/subsys/logging/Kconfig.template.log_config"
```
